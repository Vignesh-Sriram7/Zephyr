## CMakeLists.txt
```
# SPDX-License-Identifier: Apache-2.0

cmake_minimum_required(VERSION 3.20.0)
find_package(Zephyr REQUIRED HINTS $ENV{ZEPHYR_BASE})
project(STM32_Linux_Telemetry)

target_sources(app PRIVATE src/main.c)
```

## prj.conf
```kconfig
# General
CONFIG_LOG=y
CONFIG_PRINTK=y

# Enable the GPIO and the sensor drivers
CONFIG_GPIO=y  
#CONFIG_SENSOR=y
#CONFIG_DHT=y

# Enable the STM32 console and USART dependencies
CONFIG_SERIAL=y
CONFIG_UART_CONSOLE=y
CONFIG_LOG=y
CONFIG_PRINTK=y

#Enable the CDC
CONFIG_USB_DEVICE_STACK=y
CONFIG_USB_CDC_ACM=y
CONFIG_UART_INTERRUPT_DRIVEN=y

#To enable floating point computing directly to cbprintf
CONFIG_CBPRINTF_FP_SUPPORT=y
CONFIG_MINIMAL_LIBC=n
CONFIG_PICOLIBC=y
```

## boards/nucleo_f303re.overlay
```dts
/ {
    aliases {
        my-sensor = &dht11;   // Point your alias to the new dht11 node
    };

    /* Define the DHT11 sensor as a new child of the root node */
    dht11: dht11 {
        compatible = "aosong,dht";
        dio-gpios = <&gpioa 0 (GPIO_ACTIVE_HIGH | GPIO_PULL_UP)>;
        status = "okay";
    };
};

// USART2 is enabled for serial communication with the host computer for debugging and telemetry output
&usart2 {
    status = "okay";
    current-speed = <115200>;
};
```

## src/main.c
```c
#include <zephyr/kernel.h>
#include <zephyr/sys/printk.h>
//#include <zephyr/device.h> // Device configurations
//#include <zephyr/drivers/sensor.h> // BME280 implements this API

// Retrieve the defined devices from the devicetree //

//static const struct device *const dht11 = DEVICE_DT_GET(DT_ALIAS(my_sensor)); // Retrieve the Sensor device

//int main(void){
int main(void) {
    // Declare the varaibles required for the dht11 sensor
    //int ret;
    //struct sensor_value temp;
    //struct sensor_value hum;
    printk("=== STM32 Telemetry Simulator Booted ===\n");
    float base_temp = 22.5f;
    float base_hum = 45.0f;
    uint32_t timestamp = 0; 

    /* CHECK IF DEVICES ARE READY */

    //if(!device_is_ready(dht11)){
            //printk("Device %s is not ready.\n", dht11->name);
            //return 0;
        //}
    
    while(1){

        // Obtain the sensor readings
        //ret = sensor_sample_fetch(dht11);
        //if(ret < 0){
           //printk("Sample Fetch Error: %d\n", ret);
            //continue;
        //}

        //ret = sensor_channel_get(dht11, SENSOR_CHAN_AMBIENT_TEMP, &temp);
        //if(ret < 0){
            //printk("Channel Get Error: %d\n", ret);
            //continue;
        //}

        //ret = sensor_channel_get(dht11, SENSOR_CHAN_HUMIDITY, &hum);
        //if(ret<0)
        //{
            //printk("Channel Get Error: %d\n", ret);
            //continue;
        //}
        timestamp = k_uptime_get_32();
        float temp = base_temp + (timestamp % 5) * 0.2f;
        float hum = base_hum - (timestamp % 3) * 0.5f;

        // Protocol format: TEMP:XX.XX,HUM:XX.XX,TS:XXXX\n
        //printk("TEMP:%d.%02d,HUM:%d.%02d,TS:%u\n", temp.val1, (temp.val2 / 10000), hum.val1, (hum.val2 / 10000), timestamp);
        printk("TEMP:%.2f,HUM:%.2f,TS:%u\n", (double)temp, (double)hum, timestamp);
        
        k_msleep(1000);
    }
    
    return 0;
}
        
```
