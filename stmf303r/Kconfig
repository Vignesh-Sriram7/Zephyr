## stmf303r/Kconfig.board
```kconfig
config SOC_SERIES_STM32F3X
    bool "STM32F3x Series MCU"
    select ARM
    select CPU_CORTEX_M4
    select CPU_CORTEX_M_HAS_DWT
    select SOC_FAMILY_STM32
    select CPU_HAS_FPU
    select HAS_STM32CUBE
    select HAS_SWO
    depends on <choice>
    help
      Enable support for STM32F3 MCU series
```

## stmf303r/board.yml
```yaml
board:
  name: stmf303r
  full_name: Nucleo F303RE
  vendor: st
  socs:
    - name: stm32f303xe
```
