## prj.conf
```kconfig
# Remove color codes in log output
CONFIG_LOG_MODE_MINIMAL=y

# Increase stack memory to avoid crashes
CONFIG_MAIN_STACK_SIZE=4096

# Enable WiFi
CONFIG_WIFI=y

# Networking config
CONFIG_NETWORKING=y
CONFIG_NET_IPV4=y
CONFIG_NET_IPV6=y
CONFIG_NET_TCP=y
CONFIG_NET_SOCKETS=y

# Get IPv4 address from DHCP
CONFIG_NET_DHCPV4=y

# Enable DNS resolver
CONFIG_DNS_RESOLVER=y

# How long to wait for e.g. DHCP to provide an IP address (seconds)
CONFIG_NET_CONFIG_SETTINGS=y
CONFIG_NET_CONFIG_INIT_TIMEOUT=30

# Network debug config
CONFIG_NET_LOG=y

# Enable Ethernet (required for WiFi)
CONFIG_NET_L2_ETHERNET=y

CONFIG_HTTP_CLIENT=y

CONFIG_ESP32_USE_UNSUPPORTED_REVISION=y

# Enable MQTT
CONFIG_MQTT_LIB=y

CONFIG_GPIO=y
CONFIG_GPIO_INIT_PRIORITY=40

CONFIG_DHT=y
CONFIG_SENSOR=y
```

## boards/esp32_devkitc_wroom.overlay
```dts
    / {
        aliases {
            my-dht11 = &dht11;
        };

        /* DHT11 on GPIO16 */
        dht11: dht11 {
            compatible = "aosong,dht";
            dio-gpios = <&gpio 4 GPIO_ACTIVE_HIGH>;
            status = "okay";
        };
    };

    /* Enable WiFi */
    &wifi {
        status = "okay";
    };
```

## src/main.c
```c
#include <stdio.h>
#include <string.h>
#include <zephyr/kernel.h>
#include <zephyr/net/socket.h>
#include <zephyr/net/http/client.h>
#include <zephyr/net/mqtt.h>
#include <zephyr/drivers/sensor.h>
#include "wifi.h"
#include "mqtt_src.h"
#include "my_dht11.h"

LOG_MODULE_REGISTER(main, CONFIG_LOG_DEFAULT_LEVEL);
extern struct mqtt_client client_ctx;
extern bool mqtt_connected;

// Custom libraries

// WiFi settings
#define WIFI_SSID "Vodafone-0F19"
#define WIFI_PSK "baxXcWaHLt9J4xj7"

// HTTP GET settings
#define HTTP_HOST "example.com"
#define HTTP_URL "/"

// Globals
//static char response[512];

// Print the results of a DNS lookup
void print_addrinfo(struct zsock_addrinfo **results)
{
    char ipv4[INET_ADDRSTRLEN];
    char ipv6[INET6_ADDRSTRLEN];
    struct sockaddr_in *sa;
    struct sockaddr_in6 *sa6;
    struct zsock_addrinfo *rp;

    // Iterate through the results
    for (rp = *results; rp != NULL; rp = rp->ai_next) {

        // Print IPv4 address
        if (rp->ai_addr->sa_family == AF_INET) {
            sa = (struct sockaddr_in *)rp->ai_addr;
            zsock_inet_ntop(AF_INET, &sa->sin_addr, ipv4, INET_ADDRSTRLEN);
            printk("IPv4: %s\r\n", ipv4);
        }

        // Print IPv6 address
        if (rp->ai_addr->sa_family == AF_INET6) {
            sa6 = (struct sockaddr_in6 *)rp->ai_addr;
            zsock_inet_ntop(AF_INET6, &sa6->sin6_addr, ipv6, INET6_ADDRSTRLEN);
            printk("IPv6: %s\r\n", ipv6);
        }
    }
}


int main(void)
{
    struct zsock_addrinfo hints;
    struct zsock_addrinfo *res;
    //char http_request[512];
    //int sock;
    //int len;
    //uint32_t rx_total;
    int ret;

    

    // Initialize WiFi
    wifi_init();

    // Connect to the WiFi network (blocking)
    ret = wifi_connect(WIFI_SSID, WIFI_PSK);
    if (ret < 0) {
        printk("Error (%d): WiFi connection failed\r\n", ret);
        return 0;
    }

    // Wait to receive an IP address (blocking)
    wifi_wait_for_ip_addr();

    mqtt_init();
    app_mqtt_connect(&client_ctx);

    // Clear and set address info
    memset(&hints, 0, sizeof(hints));
    hints.ai_family = AF_INET;              // IPv4
    hints.ai_socktype = SOCK_STREAM;        // TCP socket

    // Perform DNS lookup
    printk("Performing DNS lookup...\r\n");
    ret = zsock_getaddrinfo(HTTP_HOST, "80", &hints, &res);
    if (ret != 0) {
        printk("Error (%d): Could not perform DNS lookup\r\n", ret);
        return 0;
    }
    else {
        print_addrinfo(&res);
        zsock_freeaddrinfo(res);
    }

    if (dht11_init() != 0) {
        printk("Failed to initialize DHT11\n");
    } else {
        printk("DHT11 initialized successfully\n");
        k_msleep(1000);
    }

    int temperature = 0;
    int humidity = 0;
    static uint32_t last_publish = 0;

    // Print the results of the DNS lookup
    //mqtt_process_loop();
    while(1)
    {

        mqtt_input(&client_ctx);
        mqtt_live(&client_ctx);
        uint32_t now = k_uptime_get_32();

    // Publish every 5 seconds if connected
    if (mqtt_connected && (now - last_publish > 5000)) {
        int temp, hum;
                if (dht11_read(&temp, &hum) == 0) {
            printk("DEBUG: DHT11 -> Temp=%d C, Hum=%d %%\n", temp, hum);
            }

        if (dht11_read(&temp, &hum) == 0) {
            char payload[64];
            snprintf(payload, sizeof(payload),
                     "{\"temperature\": %d, \"humidity\": %d}", temp, hum);

            app_mqtt_publish(&client_ctx, "esp32/sensor/dht11", payload);

            LOG_INF("Published DHT11 -> T=%d C, H=%d %%", temp, hum);
        } else {
            LOG_ERR("Failed to read DHT11");
        }

        last_publish = now;
    }

    // Short sleep to avoid busy loop
    k_msleep(100); 
    }
}
```

## src/mqtt_src.c
```c
#include <stdint.h>
#include <zephyr/kernel.h>
#include <zephyr/net/socket.h>
#include <zephyr/net/mqtt.h>
#include <zephyr/logging/log.h>
#include <zephyr/types.h>
#include <stdint.h>
#include <arpa/inet.h>

LOG_MODULE_REGISTER(mqtt_module, LOG_LEVEL_DBG);

/* MQTT broker info */
#define MQTT_BROKER_HOSTNAME "broker.emqx.io"
#define MQTT_BROKER_PORT     1883
#define MQTT_CLIENT_ID       "esp32_test"

/* MQTT RX/TX buffers */
static uint8_t rx_buffer[128];
static uint8_t tx_buffer[128];

struct mqtt_client client_ctx;
static struct sockaddr_storage broker;

bool mqtt_connected = false;


static void mqtt_event_handler(struct mqtt_client *const client,
                               const struct mqtt_evt *evt)
{
    switch (evt->type) {
    case MQTT_EVT_CONNACK:
        if (evt->result == 0) {
            mqtt_connected = true;
            printk("MQTT connected (CONNACK)\n");
        } else {
            printk("MQTT CONNACK error: %d\n", evt->result);
        }
        break;

    case MQTT_EVT_PUBACK:
        printk("PUBACK received\n");
        break;

    default:
        break;
    }
}


void mqtt_init(void)
{
    mqtt_client_init(&client_ctx);
    memset(&broker, 0, sizeof(broker));

    /* Basic client configuration */
    client_ctx.broker = &broker;
    client_ctx.evt_cb = mqtt_event_handler;

    client_ctx.client_id.utf8 = (uint8_t *)MQTT_CLIENT_ID;
    client_ctx.client_id.size = strlen(MQTT_CLIENT_ID);
    client_ctx.user_name = NULL;
    client_ctx.password = NULL;
    client_ctx.protocol_version = MQTT_VERSION_3_1_1;

    client_ctx.keepalive = 60;

    client_ctx.transport.type = MQTT_TRANSPORT_NON_SECURE;
    client_ctx.transport.tcp.sock = -1;

    client_ctx.rx_buf = rx_buffer;
    client_ctx.rx_buf_size = sizeof(rx_buffer);
    client_ctx.tx_buf = tx_buffer;
    client_ctx.tx_buf_size = sizeof(tx_buffer);

    /* DNS lookup */
    struct zsock_addrinfo *res;
    struct zsock_addrinfo hints = {
        .ai_family = AF_INET,
        .ai_socktype = SOCK_STREAM,
    };

    int rc = zsock_getaddrinfo(MQTT_BROKER_HOSTNAME, NULL, &hints, &res);
    if (rc == 0 && res != NULL) {
        struct sockaddr_in *addr = (struct sockaddr_in *)res->ai_addr;
        memcpy(&broker, addr, sizeof(struct sockaddr_in));
        ((struct sockaddr_in *)&broker)->sin_port = htons(MQTT_BROKER_PORT);

        zsock_freeaddrinfo(res);
        LOG_INF("Broker resolved: %s", MQTT_BROKER_HOSTNAME);
    } else {
        LOG_ERR("DNS resolution failed: %d", rc);
    }
}


void app_mqtt_connect(struct mqtt_client *client_ctx)
{
    int rc = mqtt_connect(client_ctx);
    if (rc != 0) {
        LOG_ERR("MQTT Connect failed [%d]", rc);
        return;
    }

    LOG_INF("Waiting for CONNACK...");

    /* Pump MQTT state machine until CONNACK arrives */
    while (!mqtt_connected) {
        mqtt_input(client_ctx);
        mqtt_live(client_ctx);
        k_msleep(50);
    }

    LOG_INF("MQTT Connected and ready to publish!");
}


int app_mqtt_publish(struct mqtt_client *client_ctx, const char *topic_str, const char *payload)
{
    struct mqtt_publish_param param;
    struct mqtt_topic topic = {
        .topic = {
            .utf8 = (uint8_t *)topic_str,
            .size = strlen(topic_str)
        },
        .qos = MQTT_QOS_0_AT_MOST_ONCE
    };

    param.message.topic = topic;
    param.message.payload.data = (uint8_t *)payload;
    param.message.payload.len = strlen(payload);
    param.message_id = k_uptime_get_32();
    param.dup_flag = 0;
    param.retain_flag = 0;

    int rc = mqtt_publish(client_ctx, &param);
    if (rc != 0) {
        LOG_ERR("MQTT Publish failed [%d]", rc);
    } else {
        LOG_INF("Published message to topic '%s'",
                param.message.topic.topic.utf8);
    }

    return rc;
}

void mqtt_process_loop(void)
{
    static uint32_t last_publish = 0;

    while (1) {
        mqtt_input(&client_ctx);
        mqtt_live(&client_ctx);

        uint32_t now = k_uptime_get_32();

        // Publish every 5 seconds
        if (mqtt_connected && (now - last_publish > 5000)) {
            const char *topic = "esp32/test";
            const char *payload = "Hello from ESP32";

            app_mqtt_publish(&client_ctx, topic, payload);

            last_publish = now;
        }

        k_msleep(100); // small sleep to avoid busy loop
    }
}
```

## src/mqtt_src.h
```c
#ifndef MQTT_SRC_H
#define MQTT_SRC_H


void app_mqtt_connect(struct mqtt_client *client_ctx);
int app_mqtt_publish(struct mqtt_client *client_ctx,
                     const char *topic_str,
                     const char *payload);
int wifi_connect(char *ssid, char *psk);
void mqtt_init(void);
void mqtt_process_loop(void);
#endif
```

## src/my_dht11.c
```c
#include <zephyr/device.h>
#include <zephyr/drivers/gpio.h>
#include <zephyr/sys/byteorder.h>
#include <zephyr/sys/util.h>
#include <zephyr/drivers/sensor.h>
#include <string.h>
#include <zephyr/kernel.h>
#include <zephyr/logging/log.h>

#include "my_dht11.h"

LOG_MODULE_REGISTER(dht11_sensor);

static const struct device *const dht =DEVICE_DT_GET(DT_NODELABEL(dht11));

int dht11_to_int(const struct sensor_value *v)
{
    return v->val1;    // val1 is integer part
}

int dht11_init(void)
{
    
    if (!device_is_ready(dht)) {
        LOG_ERR("Device not ready");
        return -ENODEV;
    }

    LOG_INF("DHT11 initialized successfully");
    return 0;
}

int dht11_read(int *temp, int *humidity)
{
    struct sensor_value t, h;
    int ret;

    ret = sensor_sample_fetch(dht);
    if (ret) {
        LOG_ERR("Sample fetch error: %d", ret);
        return ret;
    }

    ret = sensor_channel_get(dht, SENSOR_CHAN_AMBIENT_TEMP, &t);
    if (ret) {
        LOG_ERR("Temperature read error: %d", ret);
        return ret;
    }

    ret = sensor_channel_get(dht, SENSOR_CHAN_HUMIDITY, &h);
    if (ret) {
        LOG_ERR("Humidity read error: %d", ret);
        return ret;
    }
     *temp = dht11_to_int(&t);
    *humidity = dht11_to_int(&h);

    LOG_DBG("Read DHT11 -> Temp=%d C, Hum=%d %%", *temp, *humidity);

    return 0;
}
```

## src/my_dht11.h
```c
#ifndef MY_DHT11_H
#define MY_DHT11_H

int dht11_init(void);
int dht11_read(int *temp, int *humidity);

#endif // MY_DHT11_H
```

## src/wifi.c
```c
#include <string.h>
#include <zephyr/kernel.h>
#include <zephyr/net/wifi_mgmt.h>
#include <zephyr/net/net_mgmt.h>
// Event callbacks
static struct net_mgmt_event_callback wifi_cb;
static struct net_mgmt_event_callback ipv4_cb;

// Semaphores
static K_SEM_DEFINE(sem_wifi, 0, 1);
static K_SEM_DEFINE(sem_ipv4, 0, 1);

// Called when the WiFi is connected
static void on_wifi_connection_event(struct net_mgmt_event_callback *cb,
                                     uint32_t mgmt_event,
                                     struct net_if *iface)
{
    const struct wifi_status *status = (const struct wifi_status *)cb->info;

    if (mgmt_event == NET_EVENT_WIFI_CONNECT_RESULT) {
        if (status->status) {
            printk("Error (%d): Connection request failed\r\n", status->status);
        } else {
            printk("Connected!\r\n");
            k_sem_give(&sem_wifi);
        }
    } else if (mgmt_event == NET_EVENT_WIFI_DISCONNECT_RESULT) {
        if (status->status) {
            printk("Error (%d): Disconnection request failed\r\n", status->status);
        } else {
            printk("Disconnected\r\n");
            k_sem_take(&sem_wifi, K_NO_WAIT);
        }
    }
}

// Event handler for WiFi management events
static void on_ipv4_obtained(struct net_mgmt_event_callback *cb,
                             uint32_t mgmt_event,
                             struct net_if *iface)
{
    // Signal that the IP address has been obtained
    if (mgmt_event == NET_EVENT_IPV4_ADDR_ADD) {
        k_sem_give(&sem_ipv4);
    }
}

// Initialize the WiFi event callbacks
void wifi_init(void)
{
    // Initialize the event callbacks
    net_mgmt_init_event_callback(&wifi_cb,
                                 on_wifi_connection_event,
                                 NET_EVENT_WIFI_CONNECT_RESULT | NET_EVENT_WIFI_DISCONNECT_RESULT);
    net_mgmt_init_event_callback(&ipv4_cb,
                                 on_ipv4_obtained,
                                 NET_EVENT_IPV4_ADDR_ADD);
    
    // Add the event callbacks
    net_mgmt_add_event_callback(&wifi_cb);
    net_mgmt_add_event_callback(&ipv4_cb);
}

// Connect to the WiFi network (blocking)
int wifi_connect(char *ssid, char *psk)
{
    int ret;
    struct net_if *iface;
    struct wifi_connect_req_params params;

    // Get the default networking interface
    iface = net_if_get_default();

    // Fill in the connection request parameters
    params.ssid = (const uint8_t *)ssid;
    params.ssid_length = strlen(ssid);
    params.psk = (const uint8_t *)psk;
    params.psk_length = strlen(psk);
    params.security = WIFI_SECURITY_TYPE_PSK;
    params.band = WIFI_FREQ_BAND_UNKNOWN;
    params.channel = WIFI_CHANNEL_ANY;
    params.mfp = WIFI_MFP_OPTIONAL;

    // Connect to the WiFi network
    ret = net_mgmt(NET_REQUEST_WIFI_CONNECT,
                   iface,
                   &params,
                   sizeof(params));

    // Wait for the connection to complete
    k_sem_take(&sem_wifi, K_FOREVER);

    return ret;
}

// Wait for IP address (blocking)
void wifi_wait_for_ip_addr(void)
{
    struct wifi_iface_status status;
    struct net_if *iface;
    char ip_addr[NET_IPV4_ADDR_LEN];
    char gw_addr[NET_IPV4_ADDR_LEN];

    // Get interface
    iface = net_if_get_default();

    // Wait for the IPv4 address to be obtained
    k_sem_take(&sem_ipv4, K_FOREVER);

    // Get the WiFi status
    if (net_mgmt(NET_REQUEST_WIFI_IFACE_STATUS,
                 iface,
                 &status,
                 sizeof(struct wifi_iface_status))) {
        printk("Error: WiFi status request failed\r\n");
    }

    // Get the IP address
    memset(ip_addr, 0, sizeof(ip_addr));
    if (net_addr_ntop(AF_INET,
                      &iface->config.ip.ipv4->unicast[0].ipv4.address.in_addr,
                      ip_addr,
                      sizeof(ip_addr)) == NULL) {
        printk("Error: Could not convert IP address to string\r\n");
    }

    // Get the gateway address
    memset(gw_addr, 0, sizeof(gw_addr));
    if (net_addr_ntop(AF_INET,
                      &iface->config.ip.ipv4->gw,
                      gw_addr,
                      sizeof(gw_addr)) == NULL) {
        printk("Error: Could not convert gateway address to string\r\n");
    }

    // Print the WiFi status
    printk("WiFi status:\r\n");
    if (status.state >= WIFI_STATE_ASSOCIATED) {
        printk("  SSID: %-32s\r\n", status.ssid);
        printk("  Band: %s\r\n", wifi_band_txt(status.band));
        printk("  Channel: %d\r\n", status.channel);
        printk("  Security: %s\r\n", wifi_security_txt(status.security));
        printk("  IP address: %s\r\n", ip_addr);
        printk("  Gateway: %s\r\n", gw_addr);
    }
}

// Disconnect from the WiFi network
int wifi_disconnect(void)
{
    int ret;
    struct net_if *iface = net_if_get_default();

    ret = net_mgmt(NET_REQUEST_WIFI_DISCONNECT, iface, NULL, 0);

    return ret;
}
```
